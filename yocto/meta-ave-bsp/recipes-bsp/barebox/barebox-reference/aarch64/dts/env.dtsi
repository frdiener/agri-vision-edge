/* load env from GPT barebox-env partition type uuid */
#ifdef imx8mp_tqma8mpql_mba8mpxl_dts
&{/chosen/environment-sd} {
	device-path = <&usdhc2>;
};

&{/chosen/environment-emmc} {
	device-path = <&usdhc3>;
};

/delete-node/ &{usdhc2/partition@0};
/delete-node/ &{usdhc2/partition@e0000};

/delete-node/ &{usdhc3/partition@0};
/delete-node/ &{usdhc3/partition@e0000};
#endif
