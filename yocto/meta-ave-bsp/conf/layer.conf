## yocto/meta-ave-bsp/conf/machine/frdm-imx8mp.conf
```bitbake
#@TYPE: Machine
#@NAME: NXP i.MX8MPlus FRDM
#@DESCRIPTION: Machine configuration for NXP i.MX8MPlus FRDM board

SOC_FAMILY = "mx8mp"
include conf/machine/include/soc-family.inc

DEFAULTTUNE = "cortexa53-crypto"
require conf/machine/include/arm/armv8a/tune-cortexa53.inc

PREFERRED_PROVIDER_virtual/bootloader ?= "barebox-reference"
REQUIRED_VERSION_barebox-reference = "2026.06.0"

PREFERRED_PROVIDER_virtual/kernel ?= "linux-reference"

#
# Barebox
#

BAREBOX_BINARY = "barebox-nxp-imx8mp-frdm-s.img"

#
# Linux
#

KERNEL_DEVICETREE = "freescale/imx8mp-frdm.dtb"
KERNEL_IMAGETYPE = "Image.gz"

INITRAMFS_FSTYPES = "cpio.zst"

DDR_FIRMWARE_FILES = " \
    lpddr4_pmu_train_1d_imem.bin \
    lpddr4_pmu_train_1d_dmem.bin \
    lpddr4_pmu_train_2d_imem.bin \
    lpddr4_pmu_train_2d_dmem.bin \
"

#
# Machine Features
#

MACHINE_FEATURES = "usbhost vfat serial rtc habv4"

MACHINE_ESSENTIAL_EXTRA_RDEPENDS += " \
    kernel-modules \
"

# Do not include Linux kernel in the root filesystem
BAD_RECOMMENDATIONS = "kernel-image-*"
```

## yocto/meta-ave-bsp/conf/machine/frdm-imx93.conf
```bitbake
#@TYPE: Machine
#@NAME: NXP i.MX93 FRDM
#@DESCRIPTION: Machine configuration for NXP i.MX93 FRDM board

SOC_FAMILY = "mx93"
include conf/machine/include/soc-family.inc

DEFAULTTUNE = "cortexa55"
include conf/machine/include/arm/armv8-2a/tune-cortexa55.inc

PREFERRED_PROVIDER_virtual/bootloader ?= "barebox-reference"
PREFERRED_PROVIDER_virtual/kernel ?= "linux-reference"
BAREBOX_BINARY = "barebox-nxp_mx93_frdm.img"

REQUIRED_VERSION_barebox-reference = "2026.06.0"

KERNEL_DEVICETREE = "freescale/imx93-11x11-frdm.dtb"

KERNEL_IMAGETYPE = "Image.gz"

INITRAMFS_FSTYPES = "cpio.zst"

DDR_FIRMWARE_FILES = " \
	lpddr4_pmu_train_1d_imem.bin \
	lpddr4_pmu_train_1d_dmem.bin \
	lpddr4_pmu_train_2d_imem.bin \
	lpddr4_pmu_train_2d_dmem.bin \
"

MACHINE_FEATURES = "usbhost vfat serial rtc"

MACHINE_ESSENTIAL_EXTRA_RDEPENDS += "\
    kernel-modules \
    "

# Do not include Linux kernel in the root filesystem
BAD_RECOMMENDATIONS = "kernel-image-*"
```
